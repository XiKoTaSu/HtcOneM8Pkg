// SPDX-License-Identifier: GPL-2.0-only
// Copyright (c) 2013-2015, The Linux Foundation. All rights reserved.

/dts-v1/;

/ {
	#address-cells = <2>;
	#size-cells = <2>;

	// The bootloader gets really sad if it cannot find those nodes
	chosen { };

	memory@0 {
		device_type = "memory";
		/* We expect the bootloader to fill in the reg */
		reg = <0 0 0 0>;
	};
};

/ {
	/* Actually htc,project-id */
	qcom,msm-id = <QCOM_ID_APQ8074PRO_AC 0x10000>,
		      <QCOM_ID_MSM8274PRO_AC 0x10000>,
		      <QCOM_ID_MSM8674PRO_AC 0x10000>,
		      <QCOM_ID_MSM8974PRO_AC 0x10000>;

    qcom,board-id = <QCOM_BOARD_ID_MTP 0>;

	htc-m8 {
		model = "HTC One (M8)";
		compatible = "htc,m8", "qcom,msm8974";

		/* panel {
			compatible = "htc,m8-panel";

			qcom,mdss_dsi_glu_sharp_1080p_cmd {
				compatible = "htc,m8-glu-sharp-cmd";
			};
			qcom,mdss_dsi_m8_lg_1080p_video {
				compatible = "htc,m8-lg-video";
			};
			qcom,mdss_dsi_m8_lg_novatek_35595_1080p_cmd {
				compatible = "htc,m8-lg-nt35595-cmd";
			};
			qcom,mdss_dsi_m8_lg_novatek_35695_1080p_video {
				compatible = "htc,m8-lg-nt35695-video";
			};
			qcom,mdss_dsi_m8_sharp_novatek_35595_1080p_cmd {
				compatible = "htc,m8-sharp-nt35595-cmd";
			};
			qcom,mdss_dsi_m8_sharp_novatek_35695_1080p_cmd {
				compatible = "htc,m8-sharp-nt35695-cmd";
			};
			qcom,mdss_dsi_m8_sharp_novatek_35695_1080p_video {
				compatible = "htc,m8-sharp-nt35695-video";
			};
			qcom,mdss_dsi_sharp_1080p_video {
				compatible = "htc,m8-sharp-video";
			};
		};*/
	};
};
